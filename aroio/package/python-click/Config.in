## aroio/package/python-click/Config.in
```kconfig
config BR2_PACKAGE_PYTHON_CLICK
	bool "python-click"
	help
	  Composable command line interface toolkit.

	  https://palletsprojects.com/p/click/
```

## aroio/package/python-pydantic/Config.in
```kconfig
config BR2_PACKAGE_PYTHON_PYDANTIC
	bool "python-pydantic"
	select BR2_PACKAGE_PYTHON_DATACLASSES # runtime
	help
	  Data validation and settings management using python 3.6
	  type hinting.

	  https://github.com/samuelcolvin/pydantic
```

## aroio/package/python-uvloop/Config.in
```kconfig
config BR2_PACKAGE_PYTHON_UVLOOP
	bool "python-uvloop"
	help
	  Fast implementation of asyncio event loop on top of libuv.

	  http://github.com/MagicStack/uvloop
```

## aroio/package/python-websockets/Config.in
```kconfig
config BR2_PACKAGE_PYTHON_WEBSOCKETS
	bool "python-websockets"
	help
	  An implementation of the WebSocket Protocol (RFC 6455 &
	  7692).

	  https://github.com/aaugustin/websockets
```
